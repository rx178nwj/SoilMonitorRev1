## sdkconfig.defaults
```kconfig
# Enable Bluetooth
CONFIG_BT_ENABLED=y

# Set Bluetooth Host to NimBLE
#CONFIG_BT_HOST_NIMBLE=y
CONFIG_BT_NIMBLE_ENABLED=y

# Set the Bluetooth device name
CONFIG_BT_NIMBLE_SVC_GAP_DEVICE_NAME="NIMBLE-MINIMAL"

CONFIG_PM_ENABLE=y
CONFIG_FREERTOS_USE_TICKLESS_IDLE=y
#CONFIG_BT_CTRL_PM_ENABLE=y
#CONFIG_BT_CTRL_LIGHT_SLEEP_ENABLE=y
CONFIG_BT_CTRL_MODEM_SLEEP=y

#
# Flash rom size
#

CONFIG_PARTITION_TABLE_CUSTOM=y
CONFIG_PARTITION_TABLE_CUSTOM_FILENAME="partitions.csv"
CONFIG_PARTITION_TABLE_FILENAME="partitions.csv"

CONFIG_ESPTOOLPY_FLASHSIZE_4MB=y
# CONFIG_ESPTOOLPY_FLASHSIZE_8MB is not set
# CONFIG_ESPTOOLPY_FLASHSIZE_16MB is not set
# CONFIG_ESPTOOLPY_FLASHSIZE_32MB is not set
# CONFIG_ESPTOOLPY_FLASHSIZE_64MB is not set
# CONFIG_ESPTOOLPY_FLASHSIZE_128MB is not set
CONFIG_ESPTOOLPY_FLASHSIZE="4MB"

CONFIG_FREERTOS_TIMER_TASK_STACK_DEPTH=3072

#
# ESP NETIF Adapter
#
CONFIG_ESP_NETIF_IP_LOST_TIMER_INTERVAL=120
CONFIG_ESP_NETIF_TCPIP_LWIP=y
# CONFIG_ESP_NETIF_LOOPBACK is not set
CONFIG_ESP_NETIF_USES_TCPIP_WITH_BSD_API=y

# --- ADC Driver ---
# These options enable ADC calibration schemes for more accurate readings.
CONFIG_ADC_ONESHOT_CTRL_FUNC_IN_IRAM=y
CONFIG_ADC_CAL_EFUSE_TP_ENABLE=y
CONFIG_ADC_CAL_EFUSE_VREF_ENABLE=y
CONFIG_ADC_CAL_LUT_ENABLE=y

# --- WiFi Configuration ---
# NOTE: Specific SSID and Password should be set in code or via menuconfig, not hardcoded here.
# CONFIG_ESP_WIFI_AUTH_WPA2_PSK=y was removed as it's a deprecated option.
CONFIG_ESP_WIFI_ENABLED=y
CONFIG_ESP_WIFI_NVS_ENABLED=y # Store WiFi credentials in NVS

# --- TCP/IP Stack (LWIP) ---
# These are generally fine, but can be tuned for performance.
CONFIG_LWIP_TCPIP_RECVMBOX_SIZE=32
CONFIG_LWIP_TCP_MSS=1440
CONFIG_LWIP_TCP_SND_BUF_DEFAULT=5760
CONFIG_LWIP_TCP_WND_DEFAULT=5760

# --- SNTP Configuration ---
CONFIG_LWIP_SNTP_MAX_SERVERS=3
CONFIG_LWIP_SNTP_UPDATE_DELAY=3600000
```
